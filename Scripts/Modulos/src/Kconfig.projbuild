## Scripts/Modulos/src/Kconfig.projbuild
```kconfig
menu "Wireless Configuration"

    config PRIMARY_SSID
        string "Primary WiFi SSID"
        default "myssid"
        help
            SSID (network name) for the example to connect to.

    config PRIMARY_PASSWORD
        string "Prymary WiFi Password"
        default "mypassword"
        help
            WiFi password (WPA or WPA2) for the example to use.

    config SECONDARY_SSID
        string "Secondary WiFi SSID"
        default "myssid"
        help
            SSID (network name) for the example to connect to.

    config SECONDARY_PASSWORD
        string "Secondary WiFi Password"
        default "mypassword"
        help
            WiFi password (WPA or WPA2) for the example to use.
    config ESP_MAXIMUM_RETRY
        int "Maximum retry"
        default 5
        help
            Set the Maximum retry to avoid station reconnecting to the AP unlimited when the AP is really inexistent.

    config NETWORK_SCAN_LIST_SIZE
        int "Max size of scan list"
        range 0 20
        default 10
        help
            The size of array that will be used to retrieve the list of access points.

endmenu
```
